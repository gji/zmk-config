/*
 * Copyright (c) 2024 The ZMK Contributors
 *
 * SPDX-License-Identifier: MIT
 */

#include "atlas.dtsi"

&default_transform {
    col-offset = <6>;
};

&kscan0 {
    row-gpios
        = <&xiao_d 5 GPIO_ACTIVE_HIGH>   /* R0 */
        , <&xiao_d 4 GPIO_ACTIVE_HIGH>   /* R1 */
        , <&xiao_d 3 GPIO_ACTIVE_HIGH>   /* R2 */
        , <&xiao_d 2 GPIO_ACTIVE_HIGH>   /* R3 */
        , <&xiao_d 6 GPIO_ACTIVE_HIGH>   /* R4 */
        ;
    col-gpios
        = <&xiao_d 0 (GPIO_ACTIVE_HIGH | GPIO_PULL_DOWN)>   /* C0 */
        , <&xiao_d 1 (GPIO_ACTIVE_HIGH | GPIO_PULL_DOWN)>   /* C1 */
        , <&xiao_d 10 (GPIO_ACTIVE_HIGH | GPIO_PULL_DOWN)>  /* C2 */
        , <&xiao_d 9 (GPIO_ACTIVE_HIGH | GPIO_PULL_DOWN)>   /* C3 */
        , <&xiao_d 8 (GPIO_ACTIVE_HIGH | GPIO_PULL_DOWN)>   /* C4 */
        , <&xiao_d 7 (GPIO_ACTIVE_HIGH | GPIO_PULL_DOWN)>   /* C5 */
        ;
};
