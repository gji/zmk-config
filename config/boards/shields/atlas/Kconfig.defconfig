## config/boards/shields/atlas/Kconfig.defconfig
```kconfig
# Copyright (c) 2024 The ZMK Contributors
# SPDX-License-Identifier: MIT

if SHIELD_ATLAS_LEFT

config ZMK_KEYBOARD_NAME
    default "ATLAS"

config ZMK_SPLIT_ROLE_CENTRAL
    default y

endif

if SHIELD_ATLAS_LEFT || SHIELD_ATLAS_RIGHT

config ZMK_SPLIT
    default y

endif
```

## config/boards/shields/atlas/Kconfig.shield
```kconfig
# Copyright (c) 2024 The ZMK Contributors
# SPDX-License-Identifier: MIT

config SHIELD_ATLAS_LEFT
    def_bool $(shields_list_contains,atlas_left)

config SHIELD_ATLAS_RIGHT
    def_bool $(shields_list_contains,atlas_right)
```

## config/west.yml
```yaml
manifest:
  defaults:
    remote: urob
    revision: v0.1 # Pin everything to v0.1
  remotes:
    - name: urob
      url-base: https://github.com/urob
    - name: zmkfirmware
      url-base: https://github.com/zmkfirmware
    # Additional modules containing boards/shields/custom code can be listed here as well
    # See https://docs.zephyrproject.org/3.2.0/develop/west/manifest.html#projects
    - name: caksoylar
      url-base: https://github.com/caksoylar
  projects:
    - name: zmk
      remote: zmkfirmware
      revision: main
      import: app/west.yml
      
    # ZMK modules
    - name: zmk-adaptive-key
      path: modules/zmk/adaptive-key
    - name: zmk-auto-layer
      path: modules/zmk/auto-layer
    - name: zmk-helpers
      path: modules/zmk/helpers
    - name: zmk-leader-key
      revision: v0.1+locality
      path: modules/zmk/leader-key
    - name: zmk-tri-state
      path: modules/zmk/tri-state
    - name: zmk-rgbled-widget
      remote: caksoylar
      revision: main
  self:
    path: config
```
